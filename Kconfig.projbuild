## Kconfig.projbuild
```kconfig
menu "Codex Keyboard Configuration"
    config CODEX_KEYBOARD_ENABLE
        bool "Enable BLE keyboard mode"
        default y
        select BT_NIMBLE_HID_SERVICE
endmenu
```

## components/power_manager/Kconfig.projbuild
```kconfig
menu "Listener Power Manager"
    config POWER_MANAGER_ENABLE
        bool "Enable firmware low-power manager and hardware shutdown guard"
        default y

    config POWER_MANAGER_CONNECTED_IDLE_MS
        int "BLE connected idle threshold in milliseconds"
        default 30000
        depends on POWER_MANAGER_ENABLE

    config POWER_MANAGER_AUDIO_IDLE_MS
        int "Audio idle power-save threshold in milliseconds"
        default 5000
        depends on POWER_MANAGER_ENABLE

    config POWER_MANAGER_DISCONNECTED_IDLE_MS
        int "BLE disconnected idle threshold in milliseconds"
        default 30000
        depends on POWER_MANAGER_ENABLE

    config POWER_MANAGER_HARDWARE_SHUTDOWN_MS
        int "Hardware shutdown threshold in milliseconds"
        default 1800000
        depends on POWER_MANAGER_ENABLE

    config POWER_MANAGER_BATTERY_CRITICAL_PERCENT
        int "Battery percentage threshold for critical hardware shutdown"
        default 5
        depends on POWER_MANAGER_ENABLE
        range 1 100

    config POWER_MANAGER_EVALUATE_INTERVAL_MS
        int "Power manager evaluation interval in milliseconds"
        default 2000
        depends on POWER_MANAGER_ENABLE

    config POWER_MANAGER_LOW_POWER_HEALTH_INTERVAL_S
        int "System-health interval while idle in seconds"
        default 600
        depends on POWER_MANAGER_ENABLE
endmenu
```

## ports/esp32/audio_capture/Kconfig.projbuild
```kconfig
choice AUDIO_CAPTURE_MIC_TYPE
    prompt "Microphone hardware type"
    default AUDIO_CAPTURE_MIC_SPH0655_PDM
    help
        Select the microphone hardware connected to the audio capture peripheral.
        ES8311: Analog codec via I2C + I2S (legacy board).
        SPH0655: PDM digital microphone on the V2 N16R8 CLK/DOUT interface.

config AUDIO_CAPTURE_MIC_ES8311
    bool "ES8311 analog codec (legacy board)"

config AUDIO_CAPTURE_MIC_SPH0655_PDM
    bool "SPH0655 PDM digital mic (V2 N16R8)"

endchoice

config AUDIO_CAPTURE_V2_MIC_INTERFACE_VALIDATED
    bool "Enable V2 microphone capture after CLK/DOUT interface validation"
    default n
    depends on AUDIO_CAPTURE_MIC_SPH0655_PDM
    help
        Enable only for V2 hardware validation builds that must exercise the
        CLK/GPIO48 and DOUT/GPIO47 microphone path. When disabled, firmware
        reports a degraded audio path instead of pretending capture is ready.

config AUDIO_CAPTURE_PDM_AFE_WEBRTC
    bool "Use continuous WebRTC AFE for the V2 PDM microphone"
    default y
    depends on AUDIO_CAPTURE_MIC_SPH0655_PDM
    help
        Process the selected PDM microphone channel through ESP-SR's
        continuous WebRTC noise suppression and automatic gain control before
        BLE transmission. This has no voice-gated startup path: every captured
        frame is processed so the preview and final transcript receive the
        same audio stream.

config AUDIO_CAPTURE_PDM_STEREO_SLOT_CAPTURE
    bool "Read the SPH0655 PDM multiplexed slot"
    default y
    depends on AUDIO_CAPTURE_MIC_SPH0655_PDM
    help
        Listener V2.2 hardwires SPH0655 SELECT to VSS. Per the Knowles timing
        contract, that microphone drives the falling-edge PDM slot. The
        Listener V2.2 hardware capture validation maps that signal to the
        ESP32-S3 driver's left PCM slot with clk_inv disabled. Mono mode does
        not preserve an explicit channel selection, so keep this enabled.

config AUDIO_CAPTURE_SPH0655_SLOT_RIGHT
    bool "Use the right PDM slot for the SPH0655"
    default n
    depends on AUDIO_CAPTURE_PDM_STEREO_SLOT_CAPTURE
    help
        The SPH0655 SELECT strap is a board property, not a signal that may be
        inferred from boot-time ambient noise. Listener V2.2 ties SELECT to
        VSS and its physical capture validation selects the left PCM channel;
        leave this disabled for that board. Enable only for a board whose
        measured I2S mapping selects the right PCM channel.

config AUDIO_CAPTURE_SPH0655_CLK_INVERT
    bool "Invert the PDM clock for the SPH0655 timing strap"
    default n
    depends on AUDIO_CAPTURE_PDM_STEREO_SLOT_CAPTURE
    help
        Select the clock polarity validated against the SPH0655's SELECT strap.
        This is a board-timing property and is never inferred from ambient audio.
```

## ports/esp32/board_pins/Kconfig.projbuild
```kconfig
menu "Listener Board Profile"
    choice LISTENER_BOARD_PROFILE
        prompt "Listener board profile"
        default LISTENER_BOARD_PROFILE_N4

        config LISTENER_BOARD_PROFILE_N4
            bool "Voice Keyboard N4 ESP32-S3-WROOM-1-N4"
            help
                Current validation hardware profile for ESP32-S3-WROOM-1-N4:
                4 MB flash, no PSRAM, GPIO35 voice key, and the N4 pin map.

        config LISTENER_BOARD_PROFILE_V2_N16R8
            bool "Voice Keyboard V2.0 ESP32-S3-WROOM-1-N16R8"
            help
                Production V2 board profile for ESP32-S3-WROOM-1-N16R8:
                16 MB flash, 8 MB Octal PSRAM, and the V2 schematic pin map.
    endchoice

    config LISTENER_V2_ENABLE_EC11_DEEP_SLEEP_WAKE
        bool "Enable V2 EC11 key deep-sleep wake"
        default n
        depends on LISTENER_BOARD_PROFILE_V2_N16R8
        help
            Keep disabled until EC11-KEY_IO/GPIO11 isolation and off-state
            leakage are signed off on V2 hardware.
endmenu
```
